## config/boards/arm/lpgalaxy_war_driver/Kconfig.board
```kconfig
# War Driver board configuration

# Copyright (c) 2023 Pete Johanson
# SPDX-License-Identifier: MIT

config BOARD_LPGALAXY_WAR_DRIVER
	bool "LP Galaxy War Driver"
	depends on SOC_NRF52840_QIAA
```

## config/boards/arm/lpgalaxy_war_driver/Kconfig.defconfig
```kconfig
# Copyright (c) 2023 Pete Johanson
# SPDX-License-Identifier: MIT

if BOARD_LPGALAXY_WAR_DRIVER

config BOARD
	default "lpgalaxy_war_driver"

config ZMK_KEYBOARD_NAME
	default "War Driver"

if USB

config USB_NRFX
	default y

config USB_DEVICE_STACK
	default y

endif # USB

config BT_CTLR
	default BT

config ZMK_BLE
	default y

config ZMK_USB
	default y

endif # BOARD_LPGALAXY_WAR_DRIVER
```
